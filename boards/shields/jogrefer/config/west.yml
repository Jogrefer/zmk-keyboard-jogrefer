## boards/shields/jogrefer/config/west.yml
```yaml
manifest:
  remotes:
    - name: zmkfirmware
      url-base: https://github.com/zmkfirmware
    - name: zmk-keyboard-jogrefer
      url-base: https://github.com/Jogrefer
  projects:
    - name: zmk
      remote: zmkfirmware
      revision: main
      import: app/west.yml
    - name: zmk-keyboard-jogrefer
      revision: main
  self:
    path: config
```

## config/west.yml
```yaml
manifest:
  remotes:
    - name: zmkfirmware
      url-base: https://github.com/zmkfirmware
  projects:
    - name: zmk
      remote: zmkfirmware
      revision: main
      import:
        - app/west.yml
        - app/CMakeLists.txt
        - app/Kconfig
  self:
    path: config
```

## west.yml
```yaml
# This file generates the GitHub Actions matrix.
# For simple board + shield combinations, add them to the top level board and
# shield arrays, for more control, add individual board + shield combinations
# to the `include` property. You can also use the `cmake-args` property to
# pass flags to the build command and `artifact-name` to assign a name to
# distinguish build outputs from each other:

#  - board: nice_nano_v2 # nrf52840_m2

---
manifest:
  remotes:
    - name: zmkfirmware
      url-base: https://github.com/zmkfirmware
    - name: zephyrproject-rtos
      url-base: https://github.com/zephyrproject-rtos
  projects:
    - name: zmk-config
      remote: zmkfirmware
      revision: main
    - name: zephyr
      remote: zephyrproject-rtos
      revision: main
      path: zephyr
# include:
#   - board: nice_nano_v2
#     shield: jogrefer
#     cmake-args: -DCONFIG_ZMK_USB_LOGGING=y
#     artifact-name: jogrefer
```

## zmk-config/boards/shields/jogrefer/kconfig.shield
```kconfig
config SHIELD_JOGREFER_RIGHT
	def_bool $(shields_list_contains,jogrefer_right)

	config SHIELD_JOGREFER_LEFT
	def_bool $(shields_list_contains,jogrefer_left)
```
