#include "jogrefer.dtsi"

&default_transform {
// The matrix transform for this board is 6 columns over because the left half is 6 columns wide according to the matrix.
	col-offset = <6>;
};

&kscan0 {
	col-gpios =
		<&gpio P010 GPIO_ACTIVE_HIGH>, // col7 de la der
		<&gpio P111 GPIO_ACTIVE_HIGH>, // col6 de la der
		<&gpio P113 GPIO_ACTIVE_HIGH>, // col5 de la der
		<&gpio P115 GPIO_ACTIVE_HIGH>, // col4 de la der
		<&gpio P002 GPIO_ACTIVE_HIGH>, // col3 de la der
		<&gpio P029 GPIO_ACTIVE_HIGH>; // col2 de la der
		<&gpio P031 GPIO_ACTIVE_HIGH>, // col1 de la der
};