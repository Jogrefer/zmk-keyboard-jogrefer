#include "jogrefer.dtsi" 

&kscan0 {
	col-gpios =
		<&gpio P031 GPIO_ACTIVE_HIGH>, // col1 de la izq
		<&gpio P029 GPIO_ACTIVE_HIGH>; // col2 de la izq
		<&gpio P002 GPIO_ACTIVE_HIGH>, // col3 de la izq
		<&gpio P115 GPIO_ACTIVE_HIGH>, // col4 de la izq
		<&gpio P113 GPIO_ACTIVE_HIGH>, // col5 de la izq
		<&gpio P111 GPIO_ACTIVE_HIGH>, // col6 de la izq
		<&gpio P010 GPIO_ACTIVE_HIGH>, // col7 de la izq
};